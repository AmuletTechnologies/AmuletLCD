/*      File Name                Flash Index                   */
/*      ---------                -----------                   */
#define Page_1_preCache            0x20  /* File Size = 0x90   */
#define Page_1                     0x21  /* File Size = 0x138  */
/*      background_480x272_jpegtran.jpg 0x22  /* File Size = 0x7D4A -- Flash Header = 22 00 03 C2 4A 7D 00 00 66 33 33 30 10 01 E0 01 10 A5 00 00 37 7D 00 00  */
/*      Arial_24.auf               0x23  /* File Size = 0xBFC2 */
/*      fonthdr.auf                0xF   /* File Size = 0x3E   */
/*      internalram.bin            0x6   /* File Size = 0x2138 */
/*      sdramconfig.bin            0x1   /* File Size = 0x92   */
/*      rttinit.bin                0x1D  /* File Size = 0x12   */
