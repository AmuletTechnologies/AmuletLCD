/*      File Name                Flash Index                   */
/*      ---------                -----------                   */
#define Page_1_preCache            0x20  /* File Size = 0xEC   */
#define Page_1                     0x21  /* File Size = 0x32C  */
/*      Arduin_Uno_246x172.png     0x22  /* File Size = 0x2491 */
/*      background_480x272_jpegtran.jpg 0x23  /* File Size = 0x7D4A -- Flash Header = 23 00 41 43 4A 7D 00 00 66 33 33 31 10 01 E0 01 10 A5 00 00 37 7D 00 00  */
/*      sm_blue_led.png            0x24  /* File Size = 0x716  */
/*      off_led.png                0x25  /* File Size = 0x1A   */
/*      Switch-ON_75x120.png       0x26  /* File Size = 0x221A */
/*      Switch-Neutral_75x120.png  0x27  /* File Size = 0x20F6 */
/*      Switch-OFF_75x120.png      0x28  /* File Size = 0x21C2 */
/*      fonthdr.auf                0xF   /* File Size = 0x2E   */
/*      internalram.bin            0x6   /* File Size = 0x2138 */
/*      sdramconfig.bin            0x1   /* File Size = 0x92   */
/*      rttinit.bin                0x1D  /* File Size = 0x12   */
